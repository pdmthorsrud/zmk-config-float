## boards/shields/float/Kconfig.defconfig
```kconfig
if SHIELD_FLOAT_LEFT

config ZMK_KEYBOARD_NAME
    default "float"

config ZMK_SPLIT_ROLE_CENTRAL
    default y

endif

if SHIELD_FLOAT_LEFT || SHIELD_FLOAT_RIGHT

config ZMK_SPLIT
    default y

endif
```

## boards/shields/float/Kconfig.shield
```kconfig
config SHIELD_FLOAT_LEFT
    def_bool $(shields_list_contains, float_left)

config SHIELD_FLOAT_RIGHT
    def_bool $(shields_list_contains, float_right)
```
